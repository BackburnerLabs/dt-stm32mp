// SPDX-License-Identifier: (GPL-2.0+ OR BSD-3-Clause)
/*
 * Copyright (C) Savers 2024 - All Rights Reserved
 *
 * Savers MYD-LF25X (TF-A / CA35TDCID OSTL).
 *
 * Re-based onto MYiR's vanilla myb-stm32mp257x-1GB device tree so the SoM-level
 * configuration (DDR, RCC/clocks, STPMIC2, pinctrl package) comes from MYiR's
 * known-good base instead of a STM32MP257F-DK copy. The STPMIC2 regulators, DDR
 * supplies, SD/eMMC, I2C7, USART2 and OSPI all live in myb-stm32mp257x-base.dtsi.
 *
 * SoM: MYiR MYD-LF25X, STM32MP257F (AI package), 1GB LPDDR4 (1x8Gbits).
 */

/dts-v1/;

#include "myb-stm32mp257x-base.dtsi"
#include "stm32mp25-lpddr4-1x8Gbits-1x32bits-1200MHz.dtsi"
#include "stm32mp25-pinctrl.dtsi"
#include "stm32mp25xxai-pinctrl.dtsi"

/ {
	model = "Savers MYD-LF25X (STM32MP257) CA35TDCID OSTL";
	compatible = "savers,savers-myd-lf25x", "st,myb-stm32mp257x-1GB",
		     "myir,myb-stm32mp257x-1GB", "myir,myd-lf25x", "st,stm32mp257";

	aliases {
		serial0 = &usart2;
	};

	chosen {
		stdout-path = "serial0:115200n8";
	};

	memory@80000000 {
		device_type = "memory";
		reg = <0x0 0x80000000 0x0 0x40000000>;
	};
};
